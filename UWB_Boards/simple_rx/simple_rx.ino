#include "dw3000.h"

#define PIN_RST 27
#define PIN_IRQ 34
#define PIN_SS 4

#define TX_ANT_DLY 16385
#define RX_ANT_DLY 16385

#define SYNC_BYTE_1 0xAA
#define SYNC_BYTE_2 0xBB

static dwt_config_t config = {
    5,                /* Channel number. */
    DWT_PLEN_128,     /* Preamble length. Used in TX only. */
    DWT_PAC8,         /* Preamble acquisition chunk size. Used in RX only. */
    9,                /* TX preamble code. Used in TX only. */
    9,                /* RX preamble code. Used in RX only. */
    1,                /* 0 to use standard 8 symbol SFD, 1 to use non-standard 8 symbol... */
    DWT_BR_6M8,       /* Data rate. */
    DWT_PHRMODE_STD,  /* PHY header mode. */
    DWT_PHRRATE_STD,  /* PHY header rate. */
    (129 + 8 - 8),    /* SFD timeout. Used in RX only. */
    DWT_STS_MODE_OFF, /* STS disabled */
    DWT_STS_LEN_64,   /* STS length */
    DWT_PDOA_M0       /* PDOA mode off */
};

static uint8_t rx_buffer[128];
static uint32_t status_reg = 0;

void setup()
{
  Serial.begin(115200);
  UART_init();

  spiBegin(PIN_IRQ, PIN_RST);
  spiSelect(PIN_SS);

  delay(2); 

  while (!dwt_checkidlerc()) 
  {
    UART_puts("IDLE FAILED\r\n");
    while (1);
  }

  if (dwt_initialise(DWT_DW_INIT) == DWT_ERROR)
  {
    UART_puts("INIT FAILED\r\n");
    while (1);
  }

  dwt_setleds(DWT_LEDS_ENABLE | DWT_LEDS_INIT_BLINK);

  if (dwt_configure(&config)) 
  {
    UART_puts("CONFIG FAILED\r\n");
    while (1);
  }

  dwt_setrxantennadelay(RX_ANT_DLY);
  dwt_settxantennadelay(TX_ANT_DLY);
  dwt_setlnapamode(DWT_LNA_ENABLE | DWT_PA_ENABLE);

  /* Activate Receiver immediately */
  dwt_rxenable(DWT_START_RX_IMMEDIATE);
  
  UART_puts("Receiver Ready\r\n");
}

void loop()
{
  /* 1. Poll the status registry waiting for a frame arrival or an error event */
  while (!((status_reg = dwt_read32bitreg(SYS_STATUS_ID)) & (SYS_STATUS_RXFCG_BIT_MASK | SYS_STATUS_ALL_RX_TO | SYS_STATUS_ALL_RX_ERR)))
  {
    // Spin lock waiting for radio events
  };

  /* 2. Handle successful Frame Reception */
  if (status_reg & SYS_STATUS_RXFCG_BIT_MASK)
  {
    uint32_t frame_len;

    // Clear the successful RX flag bit
    dwt_write32bitreg(SYS_STATUS_ID, SYS_STATUS_RXFCG_BIT_MASK);

    // Read total frame length from the receiver info register
    frame_len = dwt_read32bitreg(RX_FINFO_ID) & RXFLEN_MASK;

    if (frame_len <= sizeof(rx_buffer))
    {
      // Extract the raw payload from the chip's internal buffer
      dwt_readrxdata(rx_buffer, frame_len, 0);

      /* * CRITICAL STEP: The DW3000 automatically includes a 2-byte 802.15.4 CRC 
       * check at the tail of the received frame length. We subtract 2 to isolate 
       * the original CAM message bytes generated by Python.
       */
      uint8_t cam_payload_len = frame_len - 2;

      /* 3. Output payload over USB using our sync layout */
      Serial.write(SYNC_BYTE_1);
      Serial.write(SYNC_BYTE_2);
      Serial.write(cam_payload_len);
      Serial.write(rx_buffer, cam_payload_len);
      Serial.flush();
    }
  }
  else
  {
    /* 4. Handle errors (Preamble timeouts, frame rejection slips) */
    dwt_write32bitreg(SYS_STATUS_ID, SYS_STATUS_ALL_RX_TO | SYS_STATUS_ALL_RX_ERR);
  }

  /* 5. Keep the receiver re-armed for the next async over-the-air packet */
  dwt_rxenable(DWT_START_RX_IMMEDIATE);
}